## app/boards/shields/dactyl/Kconfig.shield
```kconfig
config SHIELD_DACTYL_CC_LEFT
    def_bool $(shields_list_contains,dactyl)

config SHIELD_DACTYL_CC_RIGHT
    def_bool $(shields_list_contains,dactyl)
```
